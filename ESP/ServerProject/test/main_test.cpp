#include <UIPEthernet.h>
#include <PubSubClient.h>
#include <OneWire.h>
#include <DallasTemperature.h>

const char nodeId = '1';

const int oneWireBus = 32;
const int irBlasterPin = 25;

OneWire oneWire(oneWireBus);

DallasTemperature sensors(&oneWire);

byte mac[] = {0x0E, 0x96, 0x03, 0x38, 0x94, 0x92};
EthernetClient eclient;
PubSubClient client(eclient);

unsigned long lastMillis = 0;

String tempC = "";

const char *publishTopic = "/node/" + nodeId;
const char *subscribeTopic = "/node/config/" + nodeId;
const char *subconfigIP = "/node/config/ip/" + nodeId;

void connect();
void callback(char *topic, byte *payload, unsigned int length);
void sendSignal(uint16_t command[]);
void command(String command);

uint16_t off[227] = {3868, 1356, 712, 1044, 708, 1044, 708, 312, 720, 328, 704, 340, 696,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 396, 640};
uint16_t low17[227] = {3896, 1328, 676, 1080, 676, 1076, 672, 360, 672, 360, 672, 360, 676,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 324, 780};
uint16_t low18[227] = {3896, 1324, 648, 1112, 640, 1112, 644, 388, 644, 388, 644, 388, 644,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 356, 780};
uint16_t low19[227] = {3868, 1352, 716, 1044, 708, 1044, 708, 324, 712, 308, 724, 308, 724,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 360, 748};
uint16_t low20[227] = {3900, 1320, 720, 1040, 712, 1044, 708, 324, 708, 308, 724, 312, 720,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 388, 648};
uint16_t low21[227] = {3868, 1356, 712, 1044, 708, 1044, 708, 324, 708, 324, 712, 320, 712,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 388, 644};
uint16_t low22[227] = {3900, 1320, 716, 1040, 712, 1044, 732, 300, 708, 324, 708, 304, 752,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 380, 648};
uint16_t low23[227] = {3896, 1324, 680, 1080, 676, 1076, 676, 356, 672, 324, 712, 356, 676,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 356, 744};
uint16_t low24[777] = {3880, 1340, 712, 1048, 700, 1052, 700, 332, 700, 320, 716, 328, 700,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 344, 748};
uint16_t low25[777] = {3876, 1344, 676, 1084, 672, 1096, 652, 364, 696, 352, 656, 360, 672,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 344, 724};

typedef struct
{
    String temp;
    int num;
} dict;

const dict mapping[]{
    {"off", 1},
    {"17l", 2},
    {"18l", 3},
    {"19l", 4},
    {"20l", 5},
    {"21l", 6},
    {"22l", 7},
    {"23l", 8},
    {"24l", 9},
    {"25l", 10},
    {"17m", 11},
    {"18m", 12},
    {"19m", 13},
    {"20m", 14},
    {"21m", 15},
    {"22m", 16},
    {"23m", 17},
    {"24m", 18},
    {"25m", 19},
    {"17h", 20},
    {"18h", 21},
    {"19h", 22},
    {"20h", 23},
    {"21h", 24},
    {"22h", 25},
    {"23h", 26},
    {"24h", 27},
    {"25h", 28}};

void setup()
{
    Serial.begin(115200);
    Serial.println("hello");
    Ethernet.init(5);
    if (Ethernet.begin(mac) == 0)
    {
        Serial.println("Failed");
    }

    Serial.println("Temperature Logger");
    Serial.println("*********************");
    Serial.print("IP Address   : ");
    Serial.println(Ethernet.localIP());
    Serial.print("Subnet Mask  : ");
    Serial.println(Ethernet.subnetMask());
    Serial.print("Default Gateway IP: ");
    Serial.println(Ethernet.gatewayIP());
    Serial.print("DNS Server IP     : ");
    Serial.println(Ethernet.dnsServerIP());

    Serial.println("Start MQTT");
    client.setKeepAlive(90);
    client.setClient(eclient);
    client.setServer("broker.hivemq.com", 1883);
    client.setCallback(callback);
    connect();
    sensors.begin();
    pinMode(irBlasterPin, OUTPUT);
}

void loop()
{

    if (!client.connected())
    {
        Serial.println("Reconnecting");
        connect();
    }

    float temperatureC = sensors.getTempCByIndex(0);
    tempC = String(temperatureC, 3);

    // publish a message roughly every second.
    if (millis() - lastMillis > 10000)
    {
        lastMillis = millis();
        sensors.requestTemperatures();

        if (client.publish("/2110994758", (char *)tempC.c_str()))
        {
            Serial.println("Sucess");
            Serial.print(temperatureC);
            Serial.println("ºC");
        }
        else
        {
            Serial.println("Failed Publish");
        }
        Serial.println("Published");
    }
    client.loop();
}

void connect()
{
    Serial.print("connecting...");

    while (!client.connect("arduino32"))
    {
        Serial.print(".");
        Ethernet.init(5);
        if (Ethernet.begin(mac) == 0)
        {
            Serial.println("Failed");
        }
        Serial.print("IP Address   : ");
        Serial.println(Ethernet.localIP());
    }

    Serial.println("\nconnected!");

    client.subscribe(subscribeTopic);
}

void callback(char *topic, byte *payload, unsigned int length)
{
    Serial.print("Message arrived [");
    Serial.print(topic);
    Serial.print("] ");

    if (topic == "/node/config/" + nodeId)
    {
        String cmd = "";

        for (int i = 0; i < length; i++)
        {
            Serial.print((char)payload[i]);
            cmd += (char)payload[i];
        }
        Serial.println();

        command(cmd);
    }
}

void command(String command)
{
    int cmd_number = 0;

    for (int i = 0; i < sizeof(mapping) / sizeof(dict); i++)
    {
        if (command == mapping->temp)
        {
            cmd_number = mapping->num;
        }
    }

    switch (cmd_number)
    {
    case 0:
        //
    case 1:
        sendSignal(off);
        break;
    case 2:
        sendSignal(low17);
    case 3:
        sendSignal(low18);
    case 4:
        sendSignal(low19);
    case 5:
        sendSignal(low20);
    case 6:
        sendSignal(low21);
    case 7:
        sendSignal(low22);
    case 8:
        sendSignal(low23);
    case 9:
        sendSignal(low24);
    case 10:
        sendSignal(low25);
    default:
        break;
    }
}

void sendSignal(uint16_t command[])
{
    //
}

/*
Try executing mqtt callback on RTOS
*/

/*
Fourm links for help:
- https://forum.arduino.cc/t/pubsubclient-mqtt-help/681788/7
- https://forum.arduino.cc/t/library-to-publish-to-mqtt-with-qos-1/542176/2
*/