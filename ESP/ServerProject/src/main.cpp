/**
 * @file main.cpp
 * @authors Charanpreet Singh
 *          Aaditya Mahla
 *          Harshdeep Singh
 *          Ishaan Gupts
 * @brief Project Code file
 * @details Project ServoCool
 * @version 1.0
 * @copyright Copyright (c) 2023
 */
#include <SPI.h>
#include <PubSubClient.h>
#include <UIPEthernet.h>
#include <OneWire.h>
#include <DallasTemperature.h>
#include <IRsend.h>
#include <LiquidCrystal_I2C.h>

const String nodeId = "ID";
const String location = "LOC";
const int oneWireBus = 32;
const int irBlasterPin = 25;
const int siren = 26;

OneWire oneWire(oneWireBus);

DallasTemperature sensors(&oneWire);

IRsend irsend(25);

LiquidCrystal_I2C lcd(0x27, 20, 4); // set the LCD address to 0x27 for a 16 chars and 2 line display

byte mac[] = {0x0E, 0x96, 0x03, 0x38, 0x94, 0x92};
EthernetClient eclient;
PubSubClient client(eclient);

unsigned long lastMillis = 0;

String tempC = "";
float temperatureC = 0;
char temp[50];

String ACtemp = "";

const uint16_t port_number = 1883;

String domain_name_str = "<MQTT-BROKER-IP-ADDRESS>";
char domain_name[50];

String publish_topic_str = "/node/temp" + nodeId;
char publish_topic[50];

String subscribe_topic_str = "/node/config/" + nodeId;
char subscribe_topic[50];
// const char *subconfigIP = "/node/config/ip/" + nodeId;

// ---- COMMANDS ----
uint16_t off[] = {3868, 1356, 712, 1044, 708, 1044, 708, 312, 720, 328, 704, 340, 696,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 396, 640};
uint16_t low17[] = {3896, 1328, 676, 1080, 676, 1076, 672, 360, 672, 360, 672, 360, 676,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 324, 780};
uint16_t low18[] = {3896, 1324, 648, 1112, 640, 1112, 644, 388, 644, 388, 644, 388, 644,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 356, 780};
uint16_t low19[] = {3868, 1352, 716, 1044, 708, 1044, 708, 324, 712, 308, 724, 308, 724,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 360, 748};
uint16_t low20[] = {3900, 1320, 720, 1040, 712, 1044, 708, 324, 708, 308, 724, 312, 720,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 388, 648};
uint16_t low21[] = {3868, 1356, 712, 1044, 708, 1044, 708, 324, 708, 324, 712, 320, 712,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 388, 644};
uint16_t low22[] = {3900, 1320, 716, 1040, 712, 1044, 732, 300, 708, 324, 708, 304, 752,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 380, 648};
uint16_t low23[] = {3896, 1324, 680, 1080, 676, 1076, 676, 356, 672, 324, 712, 356, 676,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 356, 744};
uint16_t low24[] = {3880, 1340, 712, 1048, 700, 1052, 700, 332, 700, 320, 716, 328, 700,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 344, 748};
uint16_t low25[] = {3876, 1344, 676, 1084, 672, 1096, 652, 364, 696, 352, 656, 360, 672,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 344, 724};
uint16_t med17[] = {3836, 1396, 688, 1068, 704, 1052, 700, 248, 756, 372, 688, 348, 684,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 416, 620};
uint16_t med18[] = {3876, 1344, 672, 1084, 668, 1084, 668, 364, 668, 368, 668, 360, 672,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 424, 636};
uint16_t med19[] = {3884, 1348, 712, 1048, 700, 1052, 704, 344, 688, 344, 692, 340, 692,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 416, 620};
uint16_t med20[] = {3892, 1340, 676, 1084, 672, 1080, 668, 364, 672, 360, 672, 360, 672,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 348, 692};
uint16_t med21[] = {3900, 1324, 712, 1044, 712, 1040, 712, 304, 728, 320, 712, 320, 712,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 388, 644};
uint16_t med22[] = {3872, 1352, 716, 1040, 712, 1040, 712, 324, 708, 336, 696, 324, 708,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 356, 708};
uint16_t med23[] = {3896, 1324, 676, 1084, 644, 1108, 644, 388, 644, 388, 644, 388, 644,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 320, 784};
uint16_t med24[] = {3868, 1352, 716, 1044, 708, 1044, 708, 324, 704, 328, 704, 328, 708,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 328, 780};
uint16_t med25[] = {3868, 1352, 712, 1048, 704, 1048, 708, 340, 692, 332, 700, 340, 692,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 396, 640};
uint16_t high17[] = {3896, 1324, 716, 1044, 708, 1044, 712, 300, 732, 320, 712, 320, 712,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 360, 680};
uint16_t high18[] = {3920, 1316, 708, 1048, 708, 1044, 708, 324, 704, 328, 708, 312, 720,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 356, 776};
uint16_t high19[] = {3840, 1396, 708, 1048, 708, 1044, 708, 340, 688, 348, 688, 340, 692,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 420, 640};
uint16_t high20[] = {3880, 1340, 680, 1080, 696, 1056, 696, 328, 704, 336, 672, 360, 672,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 388, 648};
uint16_t high21[] = {3888, 1344, 676, 1080, 672, 1080, 672, 360, 672, 364, 668, 368, 668,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 344, 760};
uint16_t high22[] = {3840, 1396, 704, 1052, 704, 1048, 700, 348, 688, 332, 700, 344, 688,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 392, 644};
uint16_t high23[] = {3900, 1324, 736, 1020, 712, 1040, 712, 324, 708, 304, 728, 324, 708,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 356, 780};
uint16_t high24[] = {3868, 1352, 716, 1044, 708, 1044, 712, 320, 712, 304, 728, 324, 708,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 392, 644};
uint16_t high25[] = {3892, 1344, 676, 1080, 672, 1084, 668, 364, 668, 364, 668, 364, 668,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 388, 644};

/**
 * @brief Single dict object can store both number and it's
 *        corresponding command. When an array ic created using
 *        dict it can function as a dictionary.
 */
typedef struct
{
  String temp;
  int num;
} dict;

/**
 * @brief Stores all the cases with their corresponding commands
 *
 */
const dict mapping[]{
    {"off", 1},
    {"17l", 2},
    {"18l", 3},
    {"19l", 4},
    {"20l", 5},
    {"21l", 6},
    {"22l", 7},
    {"23l", 8},
    {"24l", 9},
    {"25l", 10},
    {"17m", 11},
    {"18m", 12},
    {"19m", 13},
    {"20m", 14},
    {"21m", 15},
    {"22m", 16},
    {"23m", 17},
    {"24m", 18},
    {"25m", 19},
    {"17h", 20},
    {"18h", 21},
    {"19h", 22},
    {"20h", 23},
    {"21h", 24},
    {"22h", 25},
    {"23h", 26},
    {"24h", 27},
    {"25h", 28}};

char degree[] = {
    0x06,
    0x09,
    0x09,
    0x06,
    0x00,
    0x00,
    0x00,
    0x00};

char tempLogo[] = {
    0x0E,
    0x0A,
    0x0A,
    0x0A,
    0x0E,
    0x1F,
    0x1F,
    0x0E};

void connect();
void callback(char *topic, byte *payload, unsigned int length);
void sendSignal(uint16_t command[]);
void command(String command);
void lcd_print(float roomTemp);

IPAddress IP;

void setup()
{
  lcd.init();
  lcd.createChar(0, degree);
  lcd.createChar(1, tempLogo);
  lcd.home();
  // Print a message to the LCD.
  lcd.backlight();
  Serial.begin(115200);
  Serial.println("hello");
  sensors.begin();
  irsend.begin();
  Ethernet.init(5);
  if (Ethernet.begin(mac) == 0)
  {
    Serial.println("Failed");
  }

  Serial.println("----------");
  Serial.println("Servo Cool");
  Serial.println("----------");
  Serial.print("IP Address        : ");
  IP = Ethernet.localIP();
  Serial.println(IP);
  Serial.print("Subnet Mask       : ");
  Serial.println(Ethernet.subnetMask());
  Serial.print("Default Gateway IP: ");
  Serial.println(Ethernet.gatewayIP());
  Serial.print("DNS Server IP     : ");
  Serial.println(Ethernet.dnsServerIP());

  domain_name_str.toCharArray(domain_name, domain_name_str.length() + 1);
  publish_topic_str.toCharArray(publish_topic, publish_topic_str.length() + 1);
  subscribe_topic_str.toCharArray(subscribe_topic, subscribe_topic_str.length() + 1);

  Serial.println("Start MQTT");
  client.setKeepAlive(90);
  client.setClient(eclient);
  client.setServer(domain_name, port_number);
  client.setCallback(callback);

  lcd_print(00);

  pinMode(25, OUTPUT);
  pinMode(26, OUTPUT);

  connect();
}

void loop()
{
  client.loop();
  if (!client.connected())
  {
    Serial.println("Reconnecting");
    connect();
  }

  // publish a message roughly every 10 second.
  if (millis() - lastMillis > 10000)
  {
    lastMillis = millis();

    sensors.requestTemperatures();

    temperatureC = sensors.getTempCByIndex(0);
    // Serial.println(temperatureC);

    lcd_print(temperatureC);

    if (temperatureC < 0 || temperatureC > 28)
    {
      digitalWrite(siren, HIGH);
    }

    String temp_str = String(temperatureC);

    String payload_str = nodeId + "," + temp_str + "," + location;
    char payload[100];

    payload_str.toCharArray(payload, payload_str.length() + 1);

    Serial.println(payload);
    Serial.println(temp);

    if (client.publish("/nodes/temp/1", payload))
    {
      Serial.println("Sucess");
      Serial.println(temperatureC);
      Serial.println("ºC");
    }
    else
    {
      Serial.println("Failed Publish");
    }
    Serial.println("Published");
  }
  // client.loop();
}

/**
 * @brief Function will check if the MQTT is connected, if it is not connected
 *        it will first try to connect with internet using LAN module and then
 *        again try to reconnect.
 */
void connect()
{
  Serial.print("connecting...");

  while (!client.connect("serverESP32", "<USERNAME>", "<PASSWORD>"))
  {
    Serial.print(".");
    Ethernet.init(5);
    if (Ethernet.begin(mac) == 0)
    {
      Serial.println("Failed");
    }
    Serial.print("IP Address   : ");
    Serial.println(Ethernet.localIP());
  }

  Serial.println("\nconnected!");

  client.subscribe("/nodes/command/1");
}

/**
 * @brief Function is executed when a message arrives on subscribed topic
 *
 * @param topic   Topic on which message has arrived
 * @param payload Message which has arrived
 * @param length  Length of the message
 */
void callback(char *topic, byte *payload, unsigned int length)
{
  Serial.print("Message arrived [");
  Serial.print(topic);
  Serial.print("] ");

  String cmd = "";

  for (int i = 0; i < length; i++)
  {
    Serial.print((char)payload[i]);
    cmd += (char)payload[i];
  }
  Serial.println();

  Serial.println(cmd);

  ACtemp = cmd;

  command(cmd);
}

/**
 * @brief Function will send command based in the recieved mqtt message
 *
 * @param command commands which needs to be executed. Ex: '17l' to set AC at 17 with low fanspeed
 */
void command(String command)
{
  int cmd_number = 0;

  for (int i = 0; i < sizeof(mapping) / sizeof(dict); i++)
  {
    if (command == mapping[i].temp)
    {
      cmd_number = mapping[i].num;
    }
  }

  Serial.println(cmd_number);

  switch (cmd_number)
  {
  case 0:
    //
  case 1:
    irsend.sendRaw(off, sizeof(off) / sizeof(off[0]), 38);
    break;
  case 2:
    irsend.sendRaw(low17, sizeof(low17) / sizeof(low17[0]), 38);
  case 3:
    irsend.sendRaw(low18, sizeof(low18) / sizeof(low18[0]), 38);
  case 4:
    irsend.sendRaw(low19, sizeof(low19) / sizeof(low19[0]), 38);
  case 5:
    irsend.sendRaw(low20, sizeof(low20) / sizeof(low20[0]), 38);
  case 6:
    irsend.sendRaw(low21, sizeof(low21) / sizeof(low21[0]), 38);
  case 7:
    irsend.sendRaw(low22, sizeof(low22) / sizeof(low22[0]), 38);
  case 8:
    irsend.sendRaw(low23, sizeof(low23) / sizeof(low23[0]), 38);
  case 9:
    irsend.sendRaw(low24, sizeof(low24) / sizeof(low24[0]), 38);
  case 10:
    irsend.sendRaw(low25, sizeof(low25) / sizeof(low25[0]), 38);
  case 11:
    irsend.sendRaw(med17, sizeof(med17) / sizeof(med17[0]), 38);
  case 12:
    irsend.sendRaw(med18, sizeof(med18) / sizeof(med18[0]), 38);
  case 13:
    irsend.sendRaw(med19, sizeof(med19) / sizeof(med19[0]), 38);
  case 14:
    irsend.sendRaw(med20, sizeof(med20) / sizeof(med20[0]), 38);
  case 15:
    irsend.sendRaw(med21, sizeof(med21) / sizeof(med21[0]), 38);
  case 16:
    irsend.sendRaw(med22, sizeof(med22) / sizeof(med22[0]), 38);
  case 17:
    irsend.sendRaw(med23, sizeof(med23) / sizeof(med23[0]), 38);
  case 18:
    irsend.sendRaw(med24, sizeof(med24) / sizeof(med24[0]), 38);
  case 19:
    irsend.sendRaw(med25, sizeof(med25) / sizeof(med25[0]), 38);
  case 20:
    irsend.sendRaw(high17, sizeof(high17) / sizeof(high17[0]), 38);
  case 21:
    irsend.sendRaw(high18, sizeof(high18) / sizeof(high18[0]), 38);
  case 22:
    irsend.sendRaw(high19, sizeof(high19) / sizeof(high19[0]), 38);
  case 23:
    irsend.sendRaw(high20, sizeof(high20) / sizeof(high20[0]), 38);
  case 24:
    irsend.sendRaw(high21, sizeof(high21) / sizeof(high21[0]), 38);
  case 25:
    irsend.sendRaw(high22, sizeof(high22) / sizeof(high22[0]), 38);
  case 26:
    irsend.sendRaw(high23, sizeof(high23) / sizeof(high23[0]), 38);
  case 27:
    irsend.sendRaw(high24, sizeof(high24) / sizeof(high24[0]), 38);
  case 28:
    irsend.sendRaw(high25, sizeof(high25) / sizeof(high25[0]), 38);
  default:
    break;
  }
}

void lcd_print(float roomTemp)
{
  lcd.clear();
  lcd.setCursor(0, 1);
  lcd.print("IP: ");
  
  lcd.print(IP);

  lcd.setCursor(0, 0);
  lcd.print("Room ");
  lcd.write(1);
  lcd.print(":");
  lcd.print(roomTemp);
  lcd.write(0);
  lcd.print("C");

  String acTemp = "";
  String acCmd = "";

  acTemp += ACtemp[0];
  acTemp += ACtemp[1];

  acCmd += ACtemp[2];

  lcd.setCursor(0, 3);
  lcd.print("AC   ");
  lcd.write(1);
  lcd.print(":");
  lcd.print(acTemp);
  lcd.write(0);
  lcd.print("C");

  lcd.setCursor(0, 2);
  lcd.print("AC Mode:");
  if (acCmd == "l")
  {
    lcd.print("LOW");
  }
  else if (acCmd == "m")
  {
    lcd.print("MEDIUM");
  }
  else if (acCmd == "h")
  {
    lcd.print("HIGH");
  }
}
